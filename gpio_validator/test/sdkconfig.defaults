## gpio_validator/test/sdkconfig.defaults
```kconfig
# esp-idf-components/gpio_validator/test/sdkconfig.defaults
# Common configurations for testing
CONFIG_UNITY_ENABLE_BACKTRACE_ON_FAIL=y
CONFIG_UNITY_ENABLE_FIXTURE=n
CONFIG_UNITY_ENABLE_IDF_TEST_RUNNER=y
CONFIG_ESPTOOLPY_FLASHSIZE_4MB=y
CONFIG_PARTITION_TABLE_SINGLE_APP_LARGE=y

CONFIG_ESPTOOLPY_FLASHSIZE="4MB"

# Increase stack size for tests if needed
CONFIG_ESP_MAIN_TASK_STACK_SIZE=4096

# Log level
CONFIG_LOG_DEFAULT_LEVEL_INFO=y
CONFIG_ESP_TASK_WDT_INIT=n
```
